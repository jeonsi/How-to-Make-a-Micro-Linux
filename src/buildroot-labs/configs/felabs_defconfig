## src/buildroot-labs/configs/felabs_defconfig
```kconfig
BR2_x86_64=y
BR2_CCACHE=y
BR2_PACKAGE_HOST_LINUX_HEADERS_CUSTOM_4_11=y
BR2_TOOLCHAIN_BUILDROOT_WCHAR=y
BR2_TOOLCHAIN_BUILDROOT_CXX=y
BR2_ECLIPSE_REGISTER=y
BR2_TARGET_GENERIC_ROOT_PASSWD="mfjbyg"
BR2_SYSTEM_DHCP="eth0"
BR2_ROOTFS_OVERLAY="board/qemu/x86_64/overlay"
BR2_LINUX_KERNEL=y
BR2_LINUX_KERNEL_CUSTOM_VERSION=y
BR2_LINUX_KERNEL_CUSTOM_VERSION_VALUE="4.11"
BR2_LINUX_KERNEL_USE_CUSTOM_CONFIG=y
BR2_LINUX_KERNEL_CUSTOM_CONFIG_FILE="board/qemu/x86_64/linux-4.11.config"
BR2_LINUX_KERNEL_INSTALL_TARGET=y
BR2_PACKAGE_NINVADERS=y
BR2_PACKAGE_ACPID=y
BR2_PACKAGE_DROPBEAR=y
BR2_PACKAGE_DROPBEAR_DISABLE_REVERSEDNS=y
BR2_PACKAGE_GESFTPSERVER=y
BR2_PACKAGE_IPERF3=y
BR2_PACKAGE_NLOAD=y
BR2_TARGET_GRUB=y
```

## src/buildroot-labs/configs/my_qemu_x86_64_defconfig
```kconfig
# Architecture
BR2_x86_64=y

# Toolchain
BR2_CCACHE=y
BR2_TOOLCHAIN_BUILDROOT_WCHAR=y
BR2_ECLIPSE_REGISTER=y

# System
BR2_SYSTEM_DHCP="eth0"
BR2_ROOTFS_OVERLAY="board/qemu/x86_64/overlay"
#BR2_TARGET_GENERIC_GETTY_PORT="tty1"
BR2_TARGET_TZ_INFO=y
BR2_TARGET_TZ_ZONELIST="default"
BR2_TARGET_LOCALTIME="Asia/Seoul"

# Filesystem
BR2_TARGET_ROOTFS_EXT2=y
BR2_TARGET_ROOTFS_TAR=y

# Linux headers same as kernel, a 4.11 series
BR2_PACKAGE_HOST_LINUX_HEADERS_CUSTOM_4_11=y

# Kernel
BR2_LINUX_KERNEL=y
BR2_LINUX_KERNEL_CUSTOM_VERSION=y
BR2_LINUX_KERNEL_CUSTOM_VERSION_VALUE="4.11"
BR2_LINUX_KERNEL_USE_CUSTOM_CONFIG=y
BR2_LINUX_KERNEL_CUSTOM_CONFIG_FILE="board/qemu/x86_64/linux-4.11.config"
BR2_LINUX_KERNEL_INSTALL_TARGET=y

# Target packages
#BR2_PACKAGE_OPENSSH=y
BR2_PACKAGE_ACPID=y
BR2_PACKAGE_DROPBEAR=y
BR2_PACKAGE_DROPBEAR_DISABLE_REVERSEDNS=y
BR2_PACKAGE_GESFTPSERVER=y
BR2_TARGET_GRUB=y
```

## src/buildroot-labs/package/ninvaders/Config.in
```kconfig
config BR2_PACKAGE_NINVADERS
	bool "ninvaders"
	depends on BR2_INSTALL_LIBSTDCPP
	select BR2_PACKAGE_NCURSES
	help
	  ninvaders is a console game

	  http://downloads.sourceforge.net/project/ninvaders/ninvaders/0.1.1/
```
